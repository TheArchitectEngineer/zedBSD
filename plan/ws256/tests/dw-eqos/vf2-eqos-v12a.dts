/*
 * The first Ethernet port of a VisionFive 2 v1.2A (Linux v6.12
 * jh7110.dtsi, jh7110-common.dtsi and
 * jh7110-starfive-visionfive-2-v1.2a.dts): no starfive,tx-use-rgmii-clk,
 * so the glue sets the transmit clock at each speed, and the PHY's delays
 * use the fixed 1900 ps receive part.  The tree gives no MAC address.
 */
/dts-v1/;
/include/ "vf2-eqos-soc.dtsi"

&soc {
	gmac0: ethernet@16030000 {
		compatible = "starfive,jh7110-dwmac", "snps,dwmac-5.20";
		reg = <0x0 0x16030000 0x0 0x10000>;
		clocks = <&aoncrg 3>, <&aoncrg 2>, <&syscrg 109>, <&aoncrg 6>, <&syscrg 111>;
		clock-names = "stmmaceth", "pclk", "ptp_ref", "tx", "gtx";
		resets = <&aoncrg 0>, <&aoncrg 1>;
		reset-names = "stmmaceth", "ahb";
		interrupts = <7>, <6>, <5>;
		interrupt-names = "macirq", "eth_wake_irq", "eth_lpi";
		rx-fifo-depth = <2048>;
		tx-fifo-depth = <2048>;
		snps,fixed-burst;
		snps,no-pbl-x8;
		snps,force_thresh_dma_mode;
		snps,axi-config = <&stmmac_axi_setup>;
		snps,txpbl = <16>;
		snps,rxpbl = <16>;
		starfive,syscon = <&aon_syscon 0xc 0x12>;
		phy-handle = <&phy0>;
		phy-mode = "rgmii-id";
		status = "okay";

		mdio {
			#address-cells = <1>;
			#size-cells = <0>;
			compatible = "snps,dwmac-mdio";

			phy0: ethernet-phy@0 {
				reg = <0>;
				rx-internal-delay-ps = <1900>;
				tx-internal-delay-ps = <1350>;
			};
		};
	};
};

/dts-v1/;
/* A tree with a disabled DesignWare UART before the enabled one. */
/ {
	#address-cells = <2>;
	#size-cells = <2>;
	soc {
		#address-cells = <2>;
		#size-cells = <2>;
		ranges;
		serial@12000000 {
			compatible = "snps,dw-apb-uart";
			reg = <0x0 0x12000000 0x0 0x10000>;
			reg-io-width = <4>;
			reg-shift = <2>;
			interrupts = <45>;
			status = "disabled";
		};
		serial@10000000 {
			compatible = "starfive,jh7110-uart", "snps,dw-apb-uart";
			reg = <0x0 0x10000000 0x0 0x10000>;
			reg-io-width = <4>;
			reg-shift = <2>;
			interrupts = <32>;
			status = "okay";
		};
	};
};

/*
 * The device tree the ZYBO's kernel gets when it boots from the SD card:
 * U-Boot SPL reads it from the card's FAT as system.dtb and enters the
 * kernel with its address, 0x01F00000, in r2, as the JTAG boot does with
 * the tree plan/tools/zybo/zybo-common.sh makes.  It carries the board's
 * 512 MiB of DDR and the command line, which names the root on the card's
 * second partition; the kernel mounts the first, the FAT, as /boot/boot0.
 * platform/armv7/tools/make-zybo-boot-files.py compiles it, and adds the
 * parameters a build gives (ZYBO_BOOTARGS) after the ones here.
 *
 * Copyright (C) 2026 Awe Morris; SPDX-License-Identifier: Zlib
 */
/dts-v1/;
/ {
	#address-cells = <1>;
	#size-cells = <1>;
	model = "Digilent ZYBO (SD boot)";
	compatible = "digilent,zynq-zybo", "xlnx,zynq-7000";
	memory@0 { device_type = "memory"; reg = <0x0 0x20000000>; };
	chosen {
		bootargs = "rootpart=/dev/mmcblk0p2";
		stdout-path = "serial0:115200n8";
	};
};
